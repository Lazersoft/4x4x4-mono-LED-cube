#include "IRremote.h"
#include <avr/pgmspace.h>

int receiver = 8;
IRrecv irrecv(receiver);
decode_results results;
int ir=0;

int row[] = {4,5,6,7};

int dial = A3;
int latchPin = 10;
int clockPin = 12;
int dataPin = 9;
int play = 0;
const int totalsize = 6;
prog_uint16_t* frames[totalsize];

//We are going to use Program memory instead of regular memory because the arduino has a limit
//on primitive data types. My setup involves an analog rotary potentiometer attached to pin A3
//in order to control the time between each frame of each animation, and an IR remote attached to control the cube,
//to pin 8. The bottom row of the LED cube is connected to pin 4, and
//2nd to 5, 3rd to 6, and top to 7. The columns of the cube are connected to 2 daisy chained
//74HC595 shift registers. Each animation is stored in an array of program memory unsigned ints
//starting with frame0. You use the output generated from the Processing.org application in order
//to generate these frames. The frames are changed by the infrared remote.

PROGMEM prog_uint16_t frame0[] = {1,0,0,0,1,3,0,0,0,1,7,0,0,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0,1};
PROGMEM prog_uint16_t frame1[] = {0,1024,0,0,1,0,1024,32,0,1,0,1056,32,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0,51};
PROGMEM prog_uint16_t frame2[] = {65535,0,0,0,1,0,65535,0,0,1,0,0,65535,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0,1};
PROGMEM prog_uint16_t frame3[] = {1,0,0,0,1,3,0,0,0,1,7,0,0,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0,1};
PROGMEM prog_uint16_t frame4[] = {1,0,0,0,1,3,0,0,0,1,7,0,0,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0,1};
PROGMEM prog_uint16_t frame5[] = {255,255,255,255,1,254,255,255,33023,1,252,255,255,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255,1};
PROGMEM prog_uint16_t frameoff[] = {0,0,0,0,0};

//Update this value with how many arrays of animations you have!
int sizes[6];


void setup(){
  pinMode(latchPin, OUTPUT);
  pinMode(clockPin, OUTPUT);
  pinMode(dataPin, OUTPUT);
  irrecv.enableIRIn();
  Serial.begin(9600);
    frames[0] = frame0;
    frames[1] = frame1;
    frames[2] = frame2;
    frames[3] = frame3;
    frames[4] = frame4;
    frames[5] = frame5;
    frames[totalsize] = frameoff;
    
    sizes[0] = sizeof(frame0)/2;
    sizes[1] = sizeof(frame1)/2;
    sizes[2] = sizeof(frame2)/2;
    sizes[3] = sizeof(frame3)/2;
    sizes[4] = sizeof(frame4)/2;
    sizes[5] = sizeof(frame5)/2;
    sizes[totalsize] = sizeof(frameoff)/2;
}
//1 and 300 and 5
int time = 100;
int mtime = 300;
int counter = 1;

int dialval;
void loop(){
  //dialval = analogRead(dial);
  //dialval = map(dialval,0,1023,0,10);
  int playis=play;
  int w=0;
  for(int i=0; i< sizes[play];i = i+5){

    int temp = counter * pgm_read_word_near(frames[play]+(i+4))+dialval;
    for(int q = 0;q<temp;q++){
      if(play != playis)
       break;
       Serial.println(temp);
     conv(pgm_read_word_near(frames[play]+i),(i-w) % 4); 
     conv(pgm_read_word_near(frames[play]+(i+1)),((i+1)-w) % 4);
     conv(pgm_read_word_near(frames[play]+(i+2)),((i+2)-w) % 4);
     conv(pgm_read_word_near(frames[play]+(i+3)),((i+3)-w) % 4);
     check();
    }
    w++;
  }
}

void conv(unsigned int num, int k){
  byte first,second,third,fourth;
  first = highByte(num);
  first = first >> 4;
  first = first << 4;
  second = highByte(num);
  second = second << 4;
  second = second >> 4;
  third = lowByte(num);
  third = third >> 4;
  third = third << 4;
  fourth = lowByte(num);
  fourth = fourth << 4;
  fourth = fourth >> 4;
  led(fourth,k,1);
  led(third,k,1);
  led(second,k,0);
  led(first,k,0);
}

void led(byte leds,int k,int r){
  pinMode(row[k],OUTPUT);
  digitalWrite(row[k],LOW);
  if(r==0){
      digitalWrite(latchPin, 0);
      shiftOut(dataPin, clockPin,MSBFIRST, leds); 
      shiftOut(dataPin, clockPin,MSBFIRST, 0);
      digitalWrite(latchPin, 1);   
  }
  else{
      digitalWrite(latchPin, 0);
      shiftOut(dataPin, clockPin,MSBFIRST, 0); 
      shiftOut(dataPin, clockPin,MSBFIRST,leds);
      digitalWrite(latchPin, 1); 
  }
    unsigned long microtime = micros();
    while (microtime+mtime > micros()){
      check();
    }
    pinMode(row[k],INPUT);
    digitalWrite(latchPin, 0);
    shiftOut(dataPin, clockPin,MSBFIRST, 0); 
    shiftOut(dataPin, clockPin,MSBFIRST, 0);
    digitalWrite(latchPin, 1);
}

void check(){
  //Check if a command is received from the infrared receiver
  
  //Serial.println(analogRead(dial));
  //analogRead(dial);
    dialval = analogRead(dial);
  dialval = map(dialval,0,1023,1,20);
       if (irrecv.decode(&results)) // have we received an IR signal?
  {
    int IRvalue=results.value;
    ir=results.value;
    delay(2);
    Serial.println(IRvalue); // display it on serial monitor in hexadecimal
    irrecv.resume();
  }
  if(ir== 25245) //play pause
   play = (play + 1) % totalsize;
  if(ir== -23971){
   if(play== totalsize)
   play = 0;
   else
    play = totalsize;
   
  }
   ir=0;
   }
